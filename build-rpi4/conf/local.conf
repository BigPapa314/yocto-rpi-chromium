## build-rpi4/conf/local.conf
```bitbake
MACHINE ??= "raspberrypi4-64"
DISTRO ?= "poky"

EXTRA_IMAGE_FEATURES ?= "debug-tweaks"

# By default disable interactive patch resolution (tasks will just fail instead):
PATCHRESOLVE = "noop"

#
# Disk Space Monitoring during the build
#
# Monitor the disk space during the build. If there is less that 1GB of space or less
# than 100K inodes in any key build location (TMPDIR, DL_DIR, SSTATE_DIR), gracefully
# shutdown the build. If there is less than 100MB or 1K inodes, perform a hard halt
# of the build. The reason for this is that running completely out of space can corrupt
# files and damages the build in ways which may not be easily recoverable.
# It's necessary to monitor /tmp, if there is no space left the build will fail
# with very exotic errors.
BB_DISKMON_DIRS ??= "\
    STOPTASKS,${TMPDIR},1G,100K \
    STOPTASKS,${DL_DIR},1G,100K \
    STOPTASKS,${SSTATE_DIR},1G,100K \
    STOPTASKS,/tmp,100M,100K \
    HALT,${TMPDIR},100M,1K \
    HALT,${DL_DIR},100M,1K \
    HALT,${SSTATE_DIR},100M,1K \
    HALT,/tmp,10M,1K"

DISTRO_FEATURES:append = " opengl wayland "

PACKAGECONFIG:pn-gdb:append = " tui"

CORE_IMAGE_EXTRA_INSTALL += "chromium-ozone-wayland networkmanager networkmanager-nmcli"

MACHINE_EXTRA_RRECOMMENDS:remove = "linux-firmware-rpidistro-bcm43455 bluez-firmware-rpidistro-bcm4345c0-hcd linux-firmware-rpidistro-bcm43456 bluez-firmware-rpidistro-bcm4345c5-hcd"

IMAGE_FSTYPES:remove = "tar.bz2 ext3"
```

## sources/meta-debug/conf/layer.conf
```bitbake
# We have a conf and classes directory, add to BBPATH
BBPATH .= ":${LAYERDIR}"

# We have recipes-* directories, add to BBFILES
BBFILES += "${LAYERDIR}/recipes-*/*/*.bb \
            ${LAYERDIR}/recipes-*/*/*.bbappend"

BBFILE_COLLECTIONS += "debug"
BBFILE_PATTERN_debug = "^${LAYERDIR}/"
BBFILE_PRIORITY_debug = "20"
LAYERVERSION_debug = "2"
LAYERSERIES_COMPAT_debug = "scarthgap"
```
